## app/home_panel/Kconfig
```kconfig
#
# D13x Hengshan-Pi home control panel
#

menuconfig D13X_HOME_PANEL
	tristate "D13x landscape home control panel"
	default n
	depends on GRAPHICS_LVGL
	select LV_USE_NUTTX
	select LV_USE_NUTTX_TOUCHSCREEN
	select LV_USE_IMAGE
	select NETUTILS_CJSON
	select NETUTILS_WEBCLIENT
	select CRYPTO_MBEDTLS
	select MBEDTLS_NET_C
	---help---
		Build the 1024x600 LVGL home control panel for Hengshan-Pi.

if D13X_HOME_PANEL

config D13X_HOME_PANEL_PRIORITY
	int "Home panel task priority"
	default 90

config D13X_HOME_PANEL_STACKSIZE
	int "Home panel task stack size"
	default 32768

config D13X_HOME_PANEL_INPUT_DEVPATH
	string "Touchscreen device path"
	default "/dev/input0"
	depends on INPUT_TOUCHSCREEN

config D13X_HOME_PANEL_MIJIA_SERVER_URL
	string "Mijia API server URL"
	default "https://mi.lladlam.top"

config D13X_HOME_PANEL_MIJIA_TIMEOUT
	int "Mijia API inactivity timeout in seconds"
	default 15
	range 3 60

config D13X_HOME_PANEL_MIJIA_MAX_RESPONSE
	int "Maximum Mijia API response size"
	default 131072
	range 32768 262144

config D13X_HOME_PANEL_MIJIA_SYNC_INTERVAL
	int "Mijia family synchronization interval in seconds"
	default 10
	range 3 300

endif
```

## board/d13x-hengshan-pi/Kconfig
```kconfig
#
# D13x Hengshan Pi 板级配置
#

if ARCH_BOARD_CUSTOM

comment "D13x Hengshan Pi Configuration Options"

config ARCH_BOARD_D13X_HENGSHAN_PI
    bool "D13x Hengshan Pi (D133EBS)"
    default y
    ---help---
        D13x Hengshan Pi development board with D133EBS chip

endif # ARCH_BOARD_CUSTOM
```

## board/d13x-hengshan-pi/pack/d13x_os.its
```
/dts-v1/;

/ {
	description = "nuttx-artinchip firmware";
	#address-cells = <1>;

	images {
		version = "1.0.0";
		seg0 {
			description = "Artinchip segment 0";
			data = /incbin/("./nuttx.bin");
			type = "firmware";
			arch = "riscv";
			os = "artinchip";
			load = <0x30040000>;
			entry = <0x30040000>;
			hash-1 {
				algo = "crc32";
			};
			hash-2 {
				algo = "md5";
			};
		};
	};

	configurations {
		default = "conf-1";
		conf-1 {
			description = "nuttx-artinchip firmware";
			firmware = "seg0";
		};
	};
};
```

## chip/d13x/Kconfig
```kconfig
#
# D13x 芯片配置
#

if ARCH_CHIP_CUSTOM

comment "D13x Configuration Options"

choice
    prompt "D13x Chip Selection"
    default ARCH_CHIP_D133EBS

config ARCH_CHIP_D133EBS
    bool "D133EBS (1MB SRAM, 8MB PSRAM, QFN100)"
    select ARCH_RV32
    select ARCH_RV_ISA_M
    select ARCH_RV_ISA_A
    select ARCH_HAVE_FPU
    select ARCH_FPU
    select ARCH_HAVE_DPFPU
    select ARCH_DPFPU
    select ARCH_RV_ISA_C
    select ONESHOT
    select ONESHOT_COUNT
    select LIBC_ATOMIC_IRQ
    ---help---
        D133EBS: RISC-V E907 @ 480MHz, 1MB SRAM, 8MB PSRAM, QFN100

endchoice

config D13X_UART0
    bool "UART0 Support"
    default y
    select UART0_SERIALDRIVER
    select ARCH_HAVE_SERIAL_TERMIOS
    ---help---
        Enable UART0 driver support

config D13X_UART0_DIAGNOSTIC
    bool "UART0 receive path diagnostic"
    depends on D13X_UART0
    default n
    ---help---
        Enable a bounded UART0 loopback test and change-driven PA1/RX status
        reports.  This is intended for board bring-up images only.

config D13X_I2C
    bool "I2C bus support"
    select I2C
    select I2C_DRIVER

if D13X_I2C

config D13X_I2C0
    bool "I2C0 bus"

config D13X_I2C1
    bool "I2C1 bus"

config D13X_I2C2
    bool "I2C2 bus"

endif

config D13X_TOUCH
    bool "Capacitive touch support"

config D13X_TOUCH_GT911
    bool "GT911 touch controller"
    depends on D13X_TOUCH && D13X_I2C2
    select INPUT
    select INPUT_TOUCHSCREEN
    select INPUT_GT9XX

config D13X_GMAC
    bool "GMAC0 RMII Ethernet support"
    select NET
    select NET_ETHERNET
    select SCHED_LPWORK
    ---help---
        Enable the D13x GMAC0 controller, external RMII PHY and MDIO bus.

config D13X_DISPLAY
    bool "LVDS display support"
    select DRIVERS_VIDEO
    select VIDEO_FB

endif # ARCH_CHIP_CUSTOM
```
